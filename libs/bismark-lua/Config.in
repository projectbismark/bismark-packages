## libs/bismark-lua/Config.in
```kconfig
# bismark-lua configuration
menu "Configuration"
    depends on PACKAGE_bismark-lua

config BISMARK_LUA_REPOSITORY
    string "Repository URL"
    help
            Do a git clone from this repository to fetch the library code.
    default "git://github.com/projectbismark/bmlua.git"

endmenu
```

## net/bismark-passive-git-tmpfs/Config.in
```kconfig
# bismark-passive-git-tmpfs configuration
menu "Configuration"
    depends on PACKAGE_bismark-passive-git-tmpfs

config BISMARK_PASSIVE_ANONYMIZE
    bool "Anonymize traces"
    help
            Whether to anonymize trace outputs before they are uploaded to the server. Anonymized traces are still subject to whitelisting.
    default y

config BISMARK_PASSIVE_UPDATE_INTERVAL
    int "Update interval in seconds"
    help
            Generate gzipped payloads with this interval.
    default 30

config BISMARK_PASSIVE_UPLOAD_INTERVAL
    int "Upload interval in minutes"
    help
            Upload new updates to the server with with interval.
    default 10

config BISMARK_PASSIVE_TARGET
    string "Build target"
    help
            Specify "debug" or "release"
    default debug

config BISMARK_PASSIVE_FREQUENT_UPDATES
    bool "Enable frequent updates"
    help
            Write small amount of usage information every 5 seconds.
    default false

config BISMARK_PASSIVE_HTTP_URL
    bool "Record hashed HTTP URLs"
    help
            Recorded hashed URLs for all traffic on port 80. No additional
            unhashed data is recorded, even for whitelisted domains.

endmenu
```

## net/bismark-passive-git/Config.in
```kconfig
# bismark-passive-git configuration
menu "Configuration"
    depends on PACKAGE_bismark-passive-git

config BISMARK_PASSIVE_ANONYMIZE
    bool "Anonymize traces"
    help
            Whether to anonymize trace outputs before they are uploaded to the server. Anonymized traces are still subject to whitelisting.
    default y

config BISMARK_PASSIVE_UPDATE_INTERVAL
    int "Update interval in seconds"
    help
            Generate gzipped payloads with this interval.
    default 30

config BISMARK_PASSIVE_UPLOAD_INTERVAL
    int "Upload interval in minutes"
    help
            Upload new updates to the server with with interval.
    default 10

config BISMARK_PASSIVE_TARGET
    string "Build target"
    help
            Specify "debug" or "release"
    default debug

endmenu
```

## net/bismark-passive-updater/Config.in
```kconfig
# bismark-passive-updater configuration
menu "Configuration"
    depends on PACKAGE_bismark-passive-updater

config BISMARK_PASSIVE_UPDATE_INTERVAL
    int "Update interval in minutes"
    help
            Generate gzipped payloads with this interval.
    default 60

endmenu
```

## utils/bismark-data-transmit/Config.in
```kconfig
# bismark-data-transmit configuration
menu "Configuration"
    depends on PACKAGE_bismark-data-transmit

config BISMARK_DATA_TRANSMIT_URL
    string "Remote URL"
    help
            The URL to which we should upload files. Must support HTTP PUT.
    default "https://projectbismark.net:8081/upload/"

config BISMARK_DATA_TRANSMIT_RETRY_INTERVAL_MINUTES
    int "Interval in minutes with which to retry failed uploads"
    help
            Retry failed uploads after this many minutes.
    default 3

endmenu
```
